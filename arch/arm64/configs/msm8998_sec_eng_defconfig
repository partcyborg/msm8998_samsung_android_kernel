## arch/arm64/configs/msm8998_sec_eng_defconfig
```kconfig
# CONFIG_RCU_FAST_NO_HZ is not set
CONFIG_CGROUPS=y
CONFIG_CGROUP_DEBUG=y
CONFIG_CGROUP_SCHED=y
# CONFIG_SCHED_AUTOGROUP is not set
CONFIG_SLUB_DEBUG=y
# CONFIG_BLK_DEV_BSG is not set
# CONFIG_IOSCHED_DEADLINE is not set
CONFIG_CLEANCACHE=y
# CONFIG_ARM64_REG_REBALANCE_ON_CTX_SW is not set
# CONFIG_BALANCE_ANON_FILE_RECLAIM is not set
CONFIG_FORCE_ALLOC_FROM_DMA_ZONE=y
CONFIG_EFI=y
CONFIG_PM_DEBUG=y
# CONFIG_CPU_BOOST is not set
CONFIG_L2TP_DEBUGFS=y
CONFIG_DNS_RESOLVER=y
# CONFIG_CFG80211_CRDA_SUPPORT is not set
CONFIG_PNP_DEBUG_MESSAGES=y
CONFIG_CMA_SIZE_MBYTES=40
CONFIG_CMA_DEBUGFS=y
# CONFIG_UID_CPUTIME is not set
# CONFIG_SKY2 is not set
# CONFIG_SMSC911X is not set
CONFIG_PHYLIB=y
# CONFIG_USB_FFS_IPC_LOGGING is not set
CONFIG_INPUT_JOYSTICK=y
CONFIG_INPUT_KEYCHORD=y
CONFIG_INPUT_GPIO=y
CONFIG_DEVMEM=y
CONFIG_DEVKMEM=y
# CONFIG_FB_ARMCLCD is not set
CONFIG_FB_VIRTUAL=y
CONFIG_MMC_RING_BUFFER=y
CONFIG_MMC_PARANOID_SD_INIT=y
CONFIG_LEDS_TRIGGER_HEARTBEAT=y
CONFIG_LEDS_TRIGGER_CPU=y
CONFIG_EDAC=y
CONFIG_EDAC_MM_EDAC=y
CONFIG_EDAC_CORTEX_ARM64=y
CONFIG_EDAC_CORTEX_ARM64_PANIC_ON_UE=y
CONFIG_IOMMU_IO_PGTABLE_FAST_SELFTEST=y
CONFIG_QCOM_COMMON_LOG=y
CONFIG_MSM_SMD_DEBUG=y
CONFIG_QCOM_DCC=y
CONFIG_MSM_GLADIATOR_ERP_V2=y
CONFIG_PANIC_ON_GLADIATOR_ERROR_V2=y
CONFIG_MSM_GLADIATOR_HANG_DETECT=y
CONFIG_MSM_CORE_HANG_DETECT=y
CONFIG_ICNSS_DEBUG=y
CONFIG_QCOM_CPUSS_DUMP=y
CONFIG_MSM_SERVICE_NOTIFIER=y
CONFIG_PHY_XGENE=y
CONFIG_MSM_TZ_LOG=y
CONFIG_EFIVAR_FS=y
# CONFIG_NETWORK_FILESYSTEMS is not set
CONFIG_DYNAMIC_DEBUG=y
# CONFIG_PAGE_OWNER is not set
# CONFIG_PAGE_OWNER_ENABLE_DEFAULT is not set
CONFIG_DEBUG_PAGEALLOC_ENABLE_DEFAULT=y
CONFIG_SLUB_DEBUG_PANIC_ON=y
# CONFIG_PAGE_POISONING is not set
# CONFIG_PAGE_POISONING_ENABLE_DEFAULT is not set
CONFIG_DEBUG_OBJECTS=y
CONFIG_DEBUG_OBJECTS_FREE=y
CONFIG_DEBUG_OBJECTS_TIMERS=y
CONFIG_DEBUG_OBJECTS_WORK=y
CONFIG_DEBUG_OBJECTS_RCU_HEAD=y
CONFIG_DEBUG_OBJECTS_PERCPU_COUNTER=y
CONFIG_SLUB_DEBUG_ON=y
CONFIG_DEBUG_KMEMLEAK=y
CONFIG_DEBUG_KMEMLEAK_EARLY_LOG_SIZE=4000
CONFIG_DEBUG_KMEMLEAK_DEFAULT_OFF=y
CONFIG_DEBUG_STACK_USAGE=y
CONFIG_DEBUG_MEMORY_INIT=y
CONFIG_LOCKUP_DETECTOR=y
CONFIG_BOOTPARAM_HARDLOCKUP_PANIC=y
CONFIG_BOOTPARAM_SOFTLOCKUP_PANIC=y
CONFIG_WQ_WATCHDOG=y
CONFIG_PANIC_ON_SCHED_BUG=y
CONFIG_PANIC_ON_RT_THROTTLING=y
CONFIG_SCHED_STACK_END_CHECK=y
CONFIG_DEBUG_SPINLOCK=y
CONFIG_DEBUG_MUTEXES=y
CONFIG_DEBUG_ATOMIC_SLEEP=y
CONFIG_DEBUG_LIST=y
CONFIG_FAULT_INJECTION=y
CONFIG_FAIL_PAGE_ALLOC=y
CONFIG_UFS_FAULT_INJECTION=y
CONFIG_FAULT_INJECTION_DEBUG_FS=y
CONFIG_FAULT_INJECTION_STACKTRACE_FILTER=y
CONFIG_QCOM_RTB=y
CONFIG_QCOM_RTB_SEPARATE_CPUS=y
# CONFIG_FUNCTION_TRACER is not set
CONFIG_TRACER_SNAPSHOT=y
CONFIG_BLK_DEV_IO_TRACE=y
CONFIG_MEMTEST=y
CONFIG_PANIC_ON_DATA_CORRUPTION=y
CONFIG_ARM64_PTDUMP=y
CONFIG_PID_IN_CONTEXTIDR=y
# CONFIG_FREE_PAGES_RDONLY is not set
# CONFIG_DEBUG_ALIGN_RODATA is not set
CONFIG_ARM64_STRICT_BREAK_BEFORE_MAKE=y
CONFIG_CORESIGHT=y
# CONFIG_CORESIGHT_LINKS_AND_SINKS is not set
CONFIG_CORESIGHT_LINK_AND_SINK_TMC=y
# CONFIG_CORESIGHT_SOURCE_ETM4X is not set
CONFIG_CORESIGHT_REMOTE_ETM=y
CONFIG_CORESIGHT_REMOTE_ETM_DEFAULT_ENABLE=0
CONFIG_CORESIGHT_QCOM_REPLICATOR=y
CONFIG_CORESIGHT_STM=y
CONFIG_CORESIGHT_HWEVENT=y
CONFIG_CORESIGHT_CTI=y
CONFIG_CORESIGHT_TPDA=y
CONFIG_CORESIGHT_TPDM=y
CONFIG_CORESIGHT_QPDI=y
CONFIG_CORESIGHT_SOURCE_DUMMY=y
CONFIG_XZ_DEC=y
CONFIG_SEC_GPIO_DVS=y
CONFIG_GPIO_QPNP_PIN_DEBUG=y
CONFIG_IPA_UT=y
CONFIG_SEC_DEBUG_SEC_WDOG_BITE=y
CONFIG_SEC_BSP_PCIE_DEV=y
CONFIG_USER_RESET_DEBUG_TEST=y
# displayport
CONFIG_SEC_DISPLAYPORT_ENG=y
# mobicore
CONFIG_TRUSTONIC_TEE_DEBUG=y
# Battery high temperature block
CONFIG_ENG_BATTERY_CONCEPT=y
#
# UFS Journal Data Tag Debug
CONFIG_JOURNAL_DATA_TAG_DEBUG=y

# CONFIG_RKP_KDP is not set
# CONFIG_RKP_NS_PROT is not set
CONFIG_RKP_CFP_TEST=y

## Rooting Prevention
# CONFIG_SEC_RESTRICT_ROOTING is not set
# CONFIG_SEC_RESTRICT_SETUID is not set
# CONFIG_SEC_RESTRICT_FORK is not set
# CONFIG_SEC_RESTRICT_ROOTING_LOG is not set

CONFIG_REGMAP_ALLOW_WRITE_DEBUGFS=y

#knox test
CONFIG_KNOX_TEST=y

# SDP KeyManagement Test for MDFPP evaluation
CONFIG_SDP_KEY_DUMP=y

CONFIG_VIDEO_ADV_DEBUG=y
```

## arch/arm64/configs/msm8998_sec_gts4llte_eur_open_defconfig
```kconfig
# msm8998_sec_gts4llte_eur_open_defconfig

CONFIG_SEC_GTS4LLTE_PROJECT=y
CONFIG_MACH_GTS4LLTE_XX=y

CONFIG_BATTERY_SAMSUNG=y
CONFIG_BATTERY_SAMSUNG_V2=y
CONFIG_BATTERY_NOTIFIER=y
CONFIG_MULTI_CHARGING=y
CONFIG_AFC_CHARGER_MODE=y
CONFIG_CHARGER_S2MU004=y
CONFIG_FUELGAUGE_S2MU004=y
CONFIG_CHARGER_BQ25898S=y
CONFIG_SAMSUNG_LPM_MODE=y
CONFIG_BATTERY_SWELLING=y
CONFIG_BATTERY_AGE_FORECAST=y
CONFIG_UPDATE_BATTERY_DATA=y
CONFIG_CALC_TIME_TO_FULL=y
CONFIG_BATTERY_CISD=y
CONFIG_AFC_CURR_CONTROL_BY_TEMP=y
CONFIG_LIMIT_CHARGING_DURING_CALL=y
#CONFIG_STEP_CHARGING=y
CONFIG_ENABLE_100MA_CHARGING_BEFORE_USB_CONFIGURED=y
#CONFIG_LEDS_SM5720_RGB=y

#DISPLAY PORT
CONFIG_FB_MSM_MDSS_DP_PANEL=y
CONFIG_SEC_DISPLAYPORT=y
CONFIG_SEC_DISPLAYPORT_LOGGER=y
CONFIG_SEC_DISPLAYPORT_BIGDATA=y

# MUIC configs
CONFIG_MFD_S2MU004=y
CONFIG_MFD_CORE=y
CONFIG_USE_MUIC=y
CONFIG_MUIC_NOTIFIER=y
CONFIG_MUIC_SUPPORT_CCIC=y
CONFIG_MUIC_S2MU004=y
CONFIG_HV_MUIC_S2MU004_AFC=y
CONFIG_VBUS_NOTIFIER=y
CONFIG_VBUS_NOTIFIER_WORK=y

# BLUETOOTH
CONFIG_BT=y
CONFIG_MSM_BT_POWER=y
CONFIG_RFKILL=y
CONFIG_BTFM_SLIM=y
CONFIG_BTFM_SLIM_WCN3990=y

# gpio expander
#CONFIG_GPIO_PCAL6524 is not set

# Display
CONFIG_PANEL_ANA38401_AMS968HH01_QXGA=y
CONFIG_PANEL_ANA38401_AMSA05RB01_WQXGA=y

# Display SUB PMIC
CONFIG_REGULATOR_S2DOS03=y
# CONFIG_REGULATOR_MAX77838 is not set

# S2MPB02 Camera SUB PMIC
CONFIG_MFD_S2MPB02=y
CONFIG_REGULATOR_S2MPB02=y


# BuckBoost SUB PMIC
CONFIG_REGULATOR_S2ABB01=y

# Audio
CONFIG_SND_SOC_WCD_MBHC_ADC=y
CONFIG_SND_SOC_WCD_MBHC_SLOW_DET=y
CONFIG_SND_SOC_TFA9896=y
CONFIG_SEC_SND_ADAPTATION=y

# DBMD
CONFIG_SND_SOC_DBMDX=y
CONFIG_SND_SOC_DBMDX_SND_CAPTURE=y

# IRIS
CONFIG_IRIS_I2C_START=10
CONFIG_IRIS_I2C_END=11
CONFIG_IRIS_GPIO_START=41
CONFIG_IRIS_GPIO_END=42

# input
CONFIG_TOUCHSCREEN_SYNAPTICS_I2C_DSX2=y
CONFIG_TOUCHSCREEN_FTS1BA90A=y
CONFIG_TOUCHSCREEN_DUMP_MODE=y
CONFIG_INPUT_WACOM=y
CONFIG_EPEN_WACOM_W9019=y

#motor
CONFIG_SS_VIBRATOR=y
CONFIG_BOOST_POWER_SHARE=y
CONFIG_MOTOR_S2MU004=y

#sensor
# CONFIG_BMI168_FACTORY is not set
CONFIG_LSM6DSL_FACTORY=y
CONFIG_AK09916C_FACTORY=y
CONFIG_LPS22HB_FACTORY=y
CONFIG_TMD490X_FACTORY=y
CONFIG_SUPPORT_TMD4906_FACTORY=y
CONFIG_SUPPORT_PROX_AUTO_CAL=y
CONFIG_SUPPORT_HIDDEN_HOLE=y
CONFIG_SLPI_MOTOR=y
CONFIG_SENSORS_SX9320=y
CONFIG_SENSORS_SX9320_WIFI=y
CONFIG_SENSORS_SX9320_WIFI_SUB=y

# Finger print sensor
CONFIG_SENSORS_FINGERPRINT=y
CONFIG_SENSORS_VFS8XXX=y
CONFIG_SENSORS_VFS9XXX=y
CONFIG_SENSORS_FP_SPI_NUMBER=12
CONFIG_SENSORS_FP_SPI_GPIO_START=81
CONFIG_SENSORS_FP_SPI_GPIO_END=84

#ccic
CONFIG_CCIC_S2MM003=y
CONFIG_CCIC_S2MM005=y

# CAMERA
CONFIG_COMPANION3=y
CONFIG_CAMERA_SYSFS_V2=y
CONFIG_CAMERA_SYSFS_CAMFW_ALL=y
#CONFIG_MSM_FRONT_EEPROM=y
# CONFIG_SAMSUNG_OIS_RUMBA_S4 is not set
CONFIG_SAMSUNG_OIS_RUMBA_S6=y
CONFIG_SENSOR_RETENTION=y
CONFIG_SAMSUNG_SECURE_CAMERA=y
CONFIG_SAMSUNG_MULTI_CAMERA=y
CONFIG_USE_CAMERA_HW_BIG_DATA=y
CONFIG_USE_ACTUATOR_FPGA=y
CONFIG_LEDS_CLASS=y
CONFIG_LEDS_CLASS_FLASH=y
CONFIG_LEDS_KTD2692=y

# EPDG
CONFIG_NET_CORE=y
CONFIG_NET_SCH_PRIO=y
CONFIG_NET_SCHED=y   #depends on CONFIG_NET  which is enabled by default.. coz not seeing in the config file
CONFIG_NET_CLS_BASIC=y # required if basic is being used as a filter. depends on CONFIG_NET_CLS so enabling it by default
CONFIG_NET_CLS=y
CONFIG_NET_CLS_ACT=y # for enabling the action target.
CONFIG_NET_ACT_MIRRED=y  # for enabling the mirred target for redirecting the packet between the devices.
CONFIG_NET_EMATCH=y   #basic uses extended matches so this has to be present
CONFIG_NET_SCH_INGRESS=y # classifier for ingress packet

# SSWAP
CONFIG_SWAP=y
CONFIG_FRONTSWAP=y
CONFIG_ZSMALLOC=y
CONFIG_ZSMALLOC_STAT=y
CONFIG_PGTABLE_MAPPING=y
CONFIG_ZSWAP=y
CONFIG_ZSWAP_MIGRATION_SUPPORT=y
CONFIG_ZSWAP_ENABLE_WRITEBACK=n
CONFIG_ZSWAP_SAME_PAGE_SHARING=n
CONFIG_ZPOOL=y
CONFIG_DIRECT_RECLAIM_FILE_PAGES_ONLY=y
CONFIG_INCREASE_MAXIMUM_SWAPPINESS=y
CONFIG_FIX_INACTIVE_RATIO=y
CONFIG_TIGHT_PGDAT_BALANCE=y
CONFIG_VNSWAP=y
CONFIG_SWAP_ENABLE_READAHEAD=n

# MMAP READAROUND
CONFIG_MMAP_READAROUND_LIMIT=32

# FPGA
CONFIG_FPGA=y
CONFIG_SPI_TO_I2C_FPGA=y



# Broadcom WiFi
# CONFIG_BROADCOM_WIFI is not set
# CONFIG_BCM4361 is not set
# CONFIG_BCMDHD_FW_PATH is not set
# CONFIG_BCMDHD_NVRAM_PATH is not set
# CONFIG_WIFI_CONTROL_FUNC is not set
# CONFIG_BROADCOM_WIFI_RESERVED_MEM is not set
# CONFIG_CFG80211_REG_NOT_UPDATED is not set
# CONFIG_WIFI_MULTICAST_LOG is not set
# CONFIG_BCMDHD_PCIE is not set
# CONFIG_BCMDHD_PREALLOC_MEMDUMP is not set
# CONFIG_BCMDHD_OOB_HOST_WAKE is not set

# QCA Wi-Fi feature
CONFIG_QCA_CLD_WLAN=y
CONFIG_QCACLD_WLAN_LFR2=y
CONFIG_QCACLD_WLAN_LFR3=y
CONFIG_QCOM_TDLS=y
CONFIG_QCACLD_FEATURE_METERING=y
CONFIG_QCOM_VOWIFI_11R=y
CONFIG_WLAN_FEATURE_11W=y
CONFIG_QCOM_LTE_COEX=y
CONFIG_WLAN_FEATURE_LPSS=y
CONFIG_QCACLD_FEATURE_NAN=y
CONFIG_WLAN_FEATURE_NAN_DATAPATH=y
CONFIG_MPC_UT_FRAMEWORK=y
CONFIG_WLAN_OFFLOAD_PACKETS=y
CONFIG_WLAN_SYNC_TSF=y
CONFIG_WLAN_FEATURE_MEMDUMP=y
CONFIG_WLAN_FEATURE_DISA=y
CONFIG_WLAN_FASTPATH=y
CONFIG_WLAN_NAPI=y
CONFIG_WLAN_TX_FLOW_CONTROL_V2=y
CONFIG_LFR_SUBNET_DETECTION=y
CONFIG_MCC_TO_SCC_SWITCH=y
CONFIG_WLAN_LRO=y
CONFIG_ICNSS=y
CONFIG_CNSS_UTILS=y
# CONFIG_FORCE_ALLOC_FROM_DMA_ZONE is not set

# UFS
CONFIG_UFS_UN_20DIGITS=y

#redriver
CONFIG_COMBO_REDRIVER=y

CONFIG_RKP_NS_PROT=n
```

## arch/arm64/configs/msm8998_sec_userdebug_defconfig
```kconfig
# CONFIG_RKP_KDP is not set
# CONFIG_RKP_NS_PROT is not set

#
# Samsung Rooting Restriction Feature
#
# CONFIG_SEC_RESTRICT_ROOTING is not set
# CONFIG_SEC_RESTRICT_SETUID is not set
# CONFIG_SEC_RESTRICT_FORK is not set
# CONFIG_SEC_RESTRICT_ROOTING_LOG is not set
CONFIG_REGMAP_ALLOW_WRITE_DEBUGFS=y
```
